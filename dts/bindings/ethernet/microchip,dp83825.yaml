## dts/bindings/ethernet/microchip,dp83825.yaml
```yaml
description: Microchip DP83825 Ethernet PHY device

compatible: "microchip,dp83825"

include: ethernet-phy.yaml

properties:
  mc,reset-gpio:
    type: phandle-array
    specifier-space: gpio
    description: GPIO connected to PHY reset signal pin. Reset is active low.
  mc,interrupt-gpio:
    type: phandle-array
    specifier-space: gpio
    description: GPIO for interrupt signal indicating PHY state change.
  mc,interface-type:
    type: string
    required: true
    description: Which type of phy connection the phy is set up for
    enum:
      - "mii"
      - "rmii"
      - "rmii-25MHz"
```
